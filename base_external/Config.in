## base_external/Config.in
```kconfig
source "$/home/chaithra/Documents/assignment-4-chaisuresh/base_external/package/aesd-assignments/Config.in"
```

## base_external/package/aesdchar/Config.in
```kconfig
config BR2_PACKAGE_AESDCHAR
	bool "aesdchar"
	help
	 to locate packages for aesd char device
	  
```
